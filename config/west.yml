## config/west.yml
```yaml
manifest:
  remotes:
    - name: zmkfirmware
      url-base: https://github.com/zmkfirmware
  projects:
    - name: zmk
      remote: zmkfirmware
      revision: main
      import: app/west.yml
    - name: SamIAm2000
      url-base: https://github.com/SamIAm2000
    - name: zmk
      remote: SamIAm2000
      revision: bongo-cat-dedicated-work-queue
      import: app/west.yml
  self:
    path: config
```
